#include <avr/interrupt.h>

unsigned int counter_16 = 0; //счётчик для подсчёта времени отпарвки сообщений
volatile unsigned char timer = 1; //флаг: можно ли отправлять сообщение

void adc_init() //инициализация АЦП
{
  ADMUX = (1 << REFS0 ); //настраивается опорное напряжение +5 В
  ADCSRA = (1 << ADEN) | (1 << ADPS2 ) | (1 << ADPS1) | (1 << ADPS0); // включение АЦП; настройка делителя 128
}

void uart_init() //инициализация uart
{
  UBRR0 = 103; //скорость передачи
  UCSR0B = (1 << TXEN0); //включение режима передачи
}

void PWM_init() //инициализация ШИМ, используется timer1
{
  TCCR1A = (1 << COM1A1) | (1 << WGM11); // неинвертирующий ШИМ на OC1A, включение режима 14 Fast PWM
  TCCR1B = (1 << WGM12) | (1 << WGM13) | (1 << CS11 ); // включние режима 14 Fast PWM, установка делителя 8
  ICR1 = 39999; // период 20 мс
  OCR1A = 1999; // импульс 1 мс
}

void timer_init() // используется timer2 для передачи данных по uart
{
  TCCR2A = (1 << WGM21); //включение режима СТС
  TCCR2B = (1 << CS22) | (1 << CS21) | (1 << CS20); //установка делителя 1024
  OCR2A = 249; // счётчик на 16 мс
  TIMSK2 = (1 << OCIE2A); //при совпадении с счётчиком разрешается прерывание
}

void setup()
{
  adc_init();
  uart_init();
  PWM_init();
  timer_init();
  DDRB |= (1 << PB1); //Подключение сигнала на сервопривод
  sei();
}

ISR(TIMER2_COMPA_vect) {
  counter_16++;
  if (counter_16 == 31) { //флаг поднимается раз в 0.5с (как раз нужно вызвать прерывние 31 раз)
    timer = 1;
    counter_16 = 0;
  }
}


unsigned int adc_read() //чтение данных с АЦП
{
  ADCSRA |= (1 << ADSC); //запуск измерения
  while (ADCSRA & (1 << ADSC)); //пока флаг не сбросится в 0 ждём
  return ADC; // возвращается измерение
}

void uart_write(char c) //отправка символа по uart
{
  while (!(UCSR0A & (1 << UDRE0))); //пока держится 0 канал занят и отправка невозможна, ждём
  UDR0 = c; //дождались 1, отправляем
}

void uart_string(const char *s) { //отправление строки по uart
  while (*s != '\0') { //пока нет символа окончания строки передаём посимвольно в uart_write
    uart_write(*s);
    s++;
  }
}

void uart_number(int q) //вывод целого 2-х значного числа со знаком
{
  if (q < 0) { //выводим знак '-', если угол отрицательный
    uart_string("-");
    q *= -1; //дальше работаем только с положительным углом
  }
  unsigned int chel = (q / 10); //первая цифра градусов
  unsigned int drob = (q % 10);//вторая цифра градусов
  if (chel != 0) // убираем лишний 0, если поворот вала <10 градусов
    uart_write(chel + '0'); //по таблице аски прибавляется '0', чтобы вывести цифру кооректно
  uart_write(drob + '0');
  uart_string("\r\n");
}

void loop() {
  unsigned int adc = adc_read(); //измерение считывается
  OCR1A = 1999 + ((unsigned long)adc * 2000 / 1023); //новое положение для сервопривода 1999 + доля * 2000: adc 0 = −90°, 1023 = +90°.
  int corner = ((long)adc * 180 / 1023) - 90; //перевод АЦП в градусы поворота вала
  if (timer == 1) { //если флаг поднят, 0.5с прошло, можно отправлять сообщение
    timer = 0;
    uart_string("angle = ");
    uart_number(corner);
  }
}
