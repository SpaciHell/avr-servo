#include <avr/interrupt.h>

unsigned int counter_16 = 0; //счётчик для подсчёта времени отпарвки сообщений
volatile unsigned char timer = 1; //флаг: можно ли отправлять сообщение
volatile int rx_mess;//переменная для хранения пришедших данных по uart
volatile int read_uart = 0; //флаг, что пришло сообщение
volatile char read_string[5] = {};//массив для хранения строки
volatile unsigned int count_read = 0; //счётчик элементов массива
int angle = 0, angle0 = 0; //угол поворота вала общий; для режима консоли
char angle_f = 0;// режим работы (АЦП или консоль)

//______________________________________БЛОК ИНИЦИАЛИЗАЦИИ__________________________________________________
void adc_init() //инициализация АЦП
{
  ADMUX = (1 << REFS0 ); //настраивается опорное напряжение +5 В
  ADCSRA = (1 << ADEN) | (1 << ADPS2 ) | (1 << ADPS1) | (1 << ADPS0); // включение АЦП; настройка делителя 128
}

void uart_init() //инициализация uart
{
  UBRR0 = 103; //скорость передачи
  UCSR0B = (1 << TXEN0) | (1 << RXEN0) | (1 << RXCIE0); //включение режима передачи и приёма, прерывание по приёму

}

void PWM_init() //инициализация ШИМ, используется timer1
{
  TCCR1A = (1 << COM1A1) | (1 << WGM11); // неинвертирующий ШИМ на OC1A, включение режима 14 Fast PWM
  TCCR1B = (1 << WGM12) | (1 << WGM13) | (1 << CS11 ); // включние режима 14 Fast PWM, установка делителя 8
  ICR1 = 39999; // период 20 мс
  OCR1A = 1999; // импульс 1 мс
}

void timer_init() // инициализация timer2 для передачи данных по uart
{
  TCCR2A = (1 << WGM21); //включение режима СТС
  TCCR2B = (1 << CS22) | (1 << CS21) | (1 << CS20); //установка делителя 1024
  OCR2A = 249; // счётчик на 16 мс
  TIMSK2 = (1 << OCIE2A); //при совпадении с счётчиком разрешается прерывание
}
//________________________________________________пока удобнее без отдельных файлов_________________________________________________________
void setup()
{
  adc_init();
  uart_init();
  PWM_init();
  timer_init();
  DDRB |= (1 << PB1); //Подключение сигнала на сервопривод
  sei();
}
//_________________________________________________ПРЕРЫВАНИЯ___________________________________________________________________________
ISR(TIMER2_COMPA_vect) {
  counter_16++;
  if (counter_16 == 31) { //флаг поднимается раз в 0.5с (как раз нужно вызвать прерывние 31 раз)
    timer = 1;
    counter_16 = 0;
  }
}

void uart_read(char c);

ISR(USART_RX_vect) {
  rx_mess = UDR0;
  uart_read(rx_mess);
}
//_______________________________________________________________________________________________________________________________________

unsigned int adc_read() //чтение данных с АЦП
{
  ADCSRA |= (1 << ADSC); //запуск измерения
  while (ADCSRA & (1 << ADSC)); //пока флаг не сбросится в 0 ждём
  return ADC; // возвращается измерение
}
//__________________________________________________________UART__________________________________________________________________________
void uart_write(char c) //ОТПРАВКА символа по uart
{
  while (!(UCSR0A & (1 << UDRE0))); //пока держится 0 канал занят и отправка невозможна, ждём
  UDR0 = c; //дождались 1, отправляем
}

void uart_string(const char *s) { //ОТПРАВКА строки по uart
  while (*s != '\0') { //пока нет символа окончания строки передаём посимвольно в uart_write
    uart_write(*s);
    s++;
  }
}

void uart_read(char c)//ПРИЁМ данных, собираются в один массив для дальнейшей работы
{
  if (c != '\r' && c != '\n') { //если не нажата кнопка энтер
    if (count_read >= 4) { //если введены лишние элементы сообщение нельзя читать
      count_read = 0; //обнуляем счётчик
    }
    read_string[count_read] = c; //заносим приходящие данные в массив
    count_read++; //прибавляем счётчик
  } else {
    read_string[count_read] = '\0'; //если нажали энтер, то закрываем строку
    read_uart = 1; //ставится флаг, что приём сообщения завершён
  }
}
//______________________________________________ОБЫЧНЫЕ ФУНКЦИИ_______________________________________________________________________________
void uart_number(int q) //вывод целого 2-х значного числа со знаком
{
  if (q < 0) { //выводим знак '-', если угол отрицательный
    uart_string("-");
    q *= -1; //дальше работаем только с положительным углом
  }
  unsigned int chel = (q / 10); //первая цифра градусов
  unsigned int drob = (q % 10);//вторая цифра градусов
  if (chel != 0) // убираем лишний 0, если поворот вала <10 градусов
    uart_write(chel + '0'); //по таблице аски прибавляется '0', чтобы вывести цифру кооректно
  uart_write(drob + '0');
  uart_string("\r\n");
}
int parse_angle(const volatile char *s, int *angle)//пришедший из консоли угол проверяется на корректность, переводится в число и возвращается
{
  int symbol = 1; //нужна для работы с отрицательными углами
  int end_digit = 0; //временная переменная для хранения угла
  if (*s == '-') { //если присутствует минус в пришедшей строке
    symbol = -1; //присваиваем отрицательно значение, чтобы домножить число
    s++; //сдвигаем указатель, так как минус не число
  }
  if (*s == '\0') //если сразу после символов строка заканчитвается, т.е. цифр нет
    return 0;
  while (*s != '\0') { //пока строка не закончилась
    if (!(*s >= '0' && *s <= '9')) //если элемент не число, выходим из функции
      return 0;
    end_digit = end_digit * 10 + (*s - '0'); //переводим символы в цифры и считаем угол
    s++; //двигаемся по массиву
  }
  if (end_digit > 90)//проверка на удовлетворение заданных границ (90;-90)
    return 0;
  *angle = end_digit * symbol;//домножаем на знак и присвиваем основной перменной
  return 1;
}

void loop() {
  if (read_uart == 1) {//проверяется поднят ли флаг, что сообщение считано и готово
    if (read_string[0] == 'p' && read_string[1] == '\0') { //проверка на наличие символа прерывания режима ручного ввода
      angle_f = 0; //включаем режим потенциометра
    } else if (read_string[0] == 'a') { //если же введено верное начало названия команды ручного ввода
      if (parse_angle(read_string + 1, &angle0)) //если функция возвращает 1
        angle_f = 1; //включается режим консоли
    }
    //любая другая команда игнорируется
    read_uart = 0; //обнуляем флаг "сообщение готово"
    count_read = 0; //обнуляем флаг счётчик элементов массива
  }

  if ( angle_f == 0) { //если режим потенциометр
    int adc = adc_read();//читаем АЦП
    angle = ((long)adc * 180 / 1023) - 90; //перевод АЦП в градусы
  } else // если режим консоли
    angle = angle0; // берём угол из режима консоли
  OCR1A = 1999 + (unsigned long)(angle + 90) * 2000 / 180;// вывод на серву
  if (timer == 1) { //если флаг поднят, 0.5с прошло, можно отправлять сообщение
    timer = 0; //обнуляем флаг таймера
    uart_string("angle = ");
    uart_number(angle);//передаём градусы
  }
}
